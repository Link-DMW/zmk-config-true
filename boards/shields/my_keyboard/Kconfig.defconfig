## boards/shields/my_keyboard/Kconfig.defconfig
```kconfig
# Copyright (c) 2021 The ZMK Contributors
# SPDX-License-Identifier: MIT

if SHIELD_MY_KEYBOARD

config ZMK_KEYBOARD_NAME
    default "tini_Keyboard"

config ZMK_STUDIO_WITH_LOCAL_UNLOCK
    bool "Enable ZMK Studio but keep local unlock key"
    default y
    depends on ZMK_STUDIO

endif
```
